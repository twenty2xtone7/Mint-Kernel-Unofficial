## arch/arm64/configs/a50_defconfig
```kconfig
CONFIG_TASK_BLOCKLIST=y

# CPU Input Boost
CONFIG_CPU_INPUT_BOOST=y
CONFIG_INPUT_BOOST_DURATION_MS=100
CONFIG_WAKE_BOOST_DURATION_MS=1000
CONFIG_INPUT_BOOST_FREQ_LP=1326000
CONFIG_INPUT_BOOST_FREQ_PERF=1794000
CONFIG_MAX_BOOST_FREQ_LP=1794000
CONFIG_MAX_BOOST_FREQ_PERF=2314000
CONFIG_MIN_FREQ_LP=208000
CONFIG_MIN_FREQ_PERF=208000
```
